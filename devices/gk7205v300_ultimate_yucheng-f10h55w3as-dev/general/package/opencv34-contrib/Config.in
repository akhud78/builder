## devices/gk7205v300_ultimate_yucheng-f10h55w3as-dev/general/package/opencv34-contrib/Config.in
```kconfig
menuconfig BR2_PACKAGE_OPENCV34_CONTRIB
	bool "opencv34-contrib"
	depends on BR2_PACKAGE_OPENCV34
	help
	  OpenCV (Open Source Computer Vision) is a library of
	  programming functions for real time computer vision.

	  http://opencv.org/
```
